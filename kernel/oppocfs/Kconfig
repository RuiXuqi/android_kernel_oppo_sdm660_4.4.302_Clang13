## kernel/oppocfs/Kconfig
```kconfig
menu "OPPO CFS"

config OPPPCFS
    bool "OPPO CFS Feature"
    default n
    ---help---
    This option enables OPPO CFS.
    
    If unsure, say Y.
    
endmenu
```
